/*
 * Copyright (c) 2021 Mike "KemoNine" Crosson
 *
 * SPDX-License-Identifier: MIT
 */

#include <behaviors.dtsi>
#include <dt-bindings/zmk/keys.h>
#include <dt-bindings/zmk/outputs.h>

/*****************************************
 * Macros for filling in "&none" in the right places in the keymap for re-use needs
 *****************************************/
#define NONE0(X)
#define NONE1(X) X
#define NONE2(X) NONE1(X) X
#define NONE3(X) NONE2(X) X
#define NONE4(X) NONE3(X) X
#define NONE5(X) NONE4(X) X
#define NONE6(X) NONE5(X) X
#define NONE7(X) NONE6(X) X
#define NONE8(X) NONE7(X) X
#define NONE9(X) NONE8(X) X
#define NONE10(X) NONE9(X) X

#define NONE(HUNDREDS,TENS,ONES) \
  NONE##HUNDREDS(NONE10(NONE10(&none))) \
  NONE##TENS(NONE10(&none)) \
  NONE##ONES(&none)

/*****************************************
 * ARTSEY website : https://www.artsey.io
 * Primary reference : https://www.artsey.io/_FILES/images/ARTSEY.jpg
*****************************************/

/*****************************************
 * Setting up ARTSEY comboing
 *   - Enabled right OR left handed orientation
 *   - Please note: A/E key positions should be on your INDEX finger
 *     - The online reference is for right handed use
 *     - When using the ARTSEY layout left handed you'll want to ensure your keypositions are flipped along the Y axis
 *   - Update/adjust the key positions using your boards keymap
 *     - See below for additional details
 *   - YOU MUST SET THE FOLLOWING CONFIG VALUES FOR THIS SETUP TO WORK PROPERLY IN YOUR BOARDS .conf FILE
 *     - CONFIG_ZMK_COMBO_MAX_COMBOS_PER_KEY=16
 *     - CONFIG_ZMK_COMBO_MAX_KEYS_PER_COMBO=8
 *     - CONFIG_ZMK_COMBO_MAX_PRESSED_COMBOS=8
 *****************************************/

/*****************************************
 * Define which layout you want to use
 *  ONLY ENABLE ONE OF THESE
*****************************************/ 
//#define ARTSEY_RIGHT 1
/* NOTE: In your corne_artsey_left.keymap you enable these before including artsey.dtsi. */
#define ARTSEY_LEFT 1
//#define ARTSEY_BIG 1
// If you use COLEMAK as your standard keyboard layout, you may want this
//#define ARTSEY_COLEMAK 1

/*****************************************
 * Define key positions used for combos
 * These definitions are used to define the various ARTSEY combos
 *
 * Please see the documentation on "combos" for details on how to find the proper key positions
 *
 * Default key positions are for a generic 4x2 keyboard and should NOT be used outright
 * DEFINE these definitions in your boards keymap BEFORE including artsey.dtsi
 *****************************************/
// ARTS Row
// #define KEY_A 0
// #define KEY_R 1
// #define KEY_T 2
// #define KEY_S 3
// EYIO Row
// #define KEY_E 4
// #define KEY_Y 5
// #define KEY_I 6
// #define KEY_O 7
// Big artsey F1-12 layer keys for combo
// #define KEY_F_TOP -1
// #define KEY_F_BOTTOM -1

/*****************************************
 * Define key position offsets in main keymap
 *
 * In order to make this keymap flexible, you must setup the number of &none "offsets" to use
 * The defines below should be set in your LOCAL keymap and using the above "NONE([hundreds],[tens],[ones])" macro for filling in the gaps
 *****************************************/
// #define LEADING_NONES NONE(0, 1, 0)
// #define MIDDLE_NONES NONE(0, 0, 3)
// #define TRAILING_NONES NONE(0, 1, 0)
// #define BIG_LEADING_NONES NONE(0, 0, 0)
// #define BIG_BETWEEN_ROW_ONE_TWO_NONES NONE(0, 0, 0)
// #define BIG_BETWEEN_ROW_TWO_THREE_NONES NONE(0, 0, 0)
// #define BIG_BETWEEN_ROW_THREE_THUMBS NONE(0, 0, 0)
// #define BIG_TRAILING_NONES NONE(0, 0, 0)

/*****************************************
 * Define custom BT layer extra keys
 *
 * You can override the 2 blank keys on the BT select layer by copy/pasting the below into your keymap
 *     *before* including the artsey.dtsi file
 * Once added to your keymap you can adjust these 2 keys as you see fit
 *****************************************/
#if !defined ARTSEY_BT_TOP
#define ARTSEY_BT_TOP &out OUT_BLE
#endif
#if !defined ARTSEY_BT_BOTTOM
#define ARTSEY_BT_BOTTOM &out OUT_USB
#endif

/*****************************************
 * Define how long it takes for the combos/holds to 'time out'
 * See documentation on "combos" for more detail
 * THE COMBO TIMEOUTS MUST BE THE SAME
 *    https://github.com/zmkfirmware/zmk/issues/905
 *****************************************/
#if !defined TIMEOUT_COMBO_2
#define TIMEOUT_COMBO_2 175
#endif
#if !defined TIMEOUT_COMBO_3
#define TIMEOUT_COMBO_3 175
#endif
#if !defined TIMEOUT_COMBO_4
#define TIMEOUT_COMBO_4 175
#endif
#if !defined TIMEOUT_LAYER_HOLD
#define TIMEOUT_LAYER_HOLD 200
#endif

/* Sticky “leader” concept can stay long. */
#if !defined TIMEOUT_STICKY_LEADER_KEY
#define TIMEOUT_STICKY_LEADER_KEY 5000
#endif

/*
 * Sticky modifier lifetime should be short to prevent accidental Win+H (voice typing)
 * when the GUI sticky combo fires unintentionally.
 */
#if !defined TIMEOUT_STICKY_MOD_KEY
#define TIMEOUT_STICKY_MOD_KEY 700
#endif

&sk {
	release-after-ms = <TIMEOUT_STICKY_MOD_KEY>;
};

&sl {
	release-after-ms = <TIMEOUT_STICKY_LEADER_KEY>;
};

/*****************************************
 * Define custom layer
 *
 * You can override this layer by copy/pasting the into your keymap *before* including the artsey.dtsi file
 * Once added to your keymap you can adjust as you see fit
 *****************************************/
#if !defined ARTSEY_LAYER_CUSTOM
#if defined ARTSEY_RIGHT
#define ARTSEY_LAYER_CUSTOM                                            \
		custom {                                                       \
			label = "Custom";                                          \
			bindings = <                                               \
				LEADING_NONES                                          \
				&kp C_MUTE &kp INS   &kp C_VOL_UP  &none               \
				MIDDLE_NONES                                           \
				&sk RSHFT  &kp PSCRN &kp C_VOL_DN  &mo LAYER_ID_CUSTOM \
				TRAILING_NONES                                         \
			>;                                                         \
		};
#endif
#if defined ARTSEY_LEFT
#define ARTSEY_LAYER_CUSTOM                                            \
		custom {                                                       \
			label = "Custom";                                          \
			bindings = <                                               \
				LEADING_NONES                                          \
				&none          &kp C_VOL_UP  &kp INS   &kp C_MUTE \
				MIDDLE_NONES                                           \
				&mo LAYER_ID_CUSTOM &kp C_VOL_DN  &kp PSCRN &sk THUMB_1  \
				TRAILING_NONES                                         \
			>;                                                         \
		};
#endif
#endif

/*****************************************
 * Standard ARTSEY combo definitions
 * These should NOT be changed and are global in scope
 *****************************************/
/ {
	combos {
		compatible = "zmk,combos";
		/*****************************************
		 * 2 key combos
		 *****************************************/
		// Function layer doesn't apply to non-big artsey presently
		#if defined ARTSEY_BIG
		combo_layer_functions { key-positions = <KEY_F_TOP KEY_F_BOTTOM>; bindings = <&sl LAYER_ID_BIG_FUNCTION>; };
		#endif
		combo_enter      { timeout-ms = <TIMEOUT_COMBO_2>; key-positions = <KEY_A KEY_E>; bindings = <&kp ENTER>; };

		combo_control    { timeout-ms = <TIMEOUT_COMBO_2>; key-positions = <KEY_E KEY_S>; bindings = <&sk LCTRL>; };
		combo_gui        { timeout-ms = <TIMEOUT_COMBO_2>; key-positions = <KEY_Y KEY_S>; bindings = <&sk LGUI>; };
		combo_alt        { timeout-ms = <TIMEOUT_COMBO_2>; key-positions = <KEY_I KEY_S>; bindings = <&sk LALT>; };

		combo_backspace  { timeout-ms = <TIMEOUT_COMBO_2>; key-positions = <KEY_E KEY_R>; bindings = <&kp BACKSPACE>; };
		combo_delete     { timeout-ms = <TIMEOUT_COMBO_2>; key-positions = <KEY_I KEY_R>; bindings = <&kp DELETE>; };
		combo_shift_lock { timeout-ms = <TIMEOUT_COMBO_2>; key-positions = <THUMB_1 KEY_Y>; bindings = <&kt LSHFT>; }; // Shift moved to Thumb_1

		combo_b           { layers = <LAYER_ID_BASE>; timeout-ms = <TIMEOUT_COMBO_2>; key-positions = <KEY_E KEY_O>; bindings = <&kp B>; };
		combo_c           { layers = <LAYER_ID_BASE>; timeout-ms = <TIMEOUT_COMBO_2>; key-positions = <KEY_E KEY_Y>; bindings = <&kp C>; };
		combo_n           { layers = <LAYER_ID_BASE>; timeout-ms = <TIMEOUT_COMBO_2>; key-positions = <KEY_I KEY_O>; bindings = <&kp ARTSEY_COMBO_N>; };
		combo_f           { layers = <LAYER_ID_BASE>; timeout-ms = <TIMEOUT_COMBO_2>; key-positions = <KEY_A KEY_R>; bindings = <&kp F>; };
		combo_g           { layers = <LAYER_ID_BASE>; timeout-ms = <TIMEOUT_COMBO_2>; key-positions = <KEY_R KEY_T>; bindings = <&kp G>; };
		combo_u           { layers = <LAYER_ID_BASE>; timeout-ms = <TIMEOUT_COMBO_2>; key-positions = <KEY_Y KEY_I>; bindings = <&kp U>; };
		combo_h           { layers = <LAYER_ID_BASE>; timeout-ms = <TIMEOUT_COMBO_2>; key-positions = <KEY_E KEY_I>; bindings = <&kp H>; };
		combo_v           { layers = <LAYER_ID_BASE>; timeout-ms = <TIMEOUT_COMBO_2>; key-positions = <KEY_R KEY_S>; bindings = <&kp V>; };
		combo_j           { layers = <LAYER_ID_BASE>; timeout-ms = <TIMEOUT_COMBO_2>; key-positions = <KEY_T KEY_S>; bindings = <&kp J>; };
		combo_w           { layers = <LAYER_ID_BASE>; timeout-ms = <TIMEOUT_COMBO_2>; key-positions = <KEY_A KEY_S>; bindings = <&kp W>; };
		combo_k           { layers = <LAYER_ID_BASE>; timeout-ms = <TIMEOUT_COMBO_2>; key-positions = <KEY_Y KEY_O>; bindings = <&kp K>; };
		combo_comma       { layers = <LAYER_ID_BASE>; timeout-ms = <TIMEOUT_COMBO_2>; key-positions = <KEY_A KEY_Y>; bindings = <&kp COMMA>; };
		combo_period      { layers = <LAYER_ID_BASE>; timeout-ms = <TIMEOUT_COMBO_2>; key-positions = <KEY_A KEY_I>; bindings = <&kp PERIOD>; };
		combo_slash       { layers = <LAYER_ID_BASE>; timeout-ms = <TIMEOUT_COMBO_2>; key-positions = <KEY_A KEY_O>; bindings = <&kp SLASH>; };
		combo_exclamation { layers = <LAYER_ID_BASE>; timeout-ms = <TIMEOUT_COMBO_2>; key-positions = <KEY_T KEY_I>; bindings = <&kp EXCL>; };

		combo_seven { layers = <LAYER_ID_NUMBERS>; timeout-ms = <TIMEOUT_COMBO_2>; key-positions = <KEY_A KEY_R>; bindings = <&kp N7>; };
		combo_eight { layers = <LAYER_ID_NUMBERS>; timeout-ms = <TIMEOUT_COMBO_2>; key-positions = <KEY_R KEY_T>; bindings = <&kp N8>; };
		combo_nine  { layers = <LAYER_ID_NUMBERS>; timeout-ms = <TIMEOUT_COMBO_2>; key-positions = <KEY_E KEY_Y>; bindings = <&kp N9>; };
		combo_zero  { layers = <LAYER_ID_NUMBERS>; timeout-ms = <TIMEOUT_COMBO_2>; key-positions = <KEY_Y KEY_I>; bindings = <&kp N0>; };

		/*****************************************
		 * 3 key combos
		 *****************************************/
		combo_esc              { timeout-ms = <TIMEOUT_COMBO_3>; key-positions = <KEY_A KEY_R KEY_O>; bindings = <&kp ESC>; };
		combo_layer_navigation { timeout-ms = <TIMEOUT_COMBO_3>; key-positions = <KEY_R KEY_E KEY_I>; bindings = <&tog LAYER_ID_NAVIGATION>; };

		combo_m            { layers = <LAYER_ID_BASE>; timeout-ms = <TIMEOUT_COMBO_3>; key-positions = <KEY_Y KEY_I KEY_O>; bindings = <&kp M>; };
		combo_d            { layers = <LAYER_ID_BASE>; timeout-ms = <TIMEOUT_COMBO_3>; key-positions = <KEY_A KEY_R KEY_T>; bindings = <&kp D>; };
		combo_p            { layers = <LAYER_ID_BASE>; timeout-ms = <TIMEOUT_COMBO_3>; key-positions = <KEY_E KEY_I KEY_O>; bindings = <&kp P>; };
		combo_q            { layers = <LAYER_ID_BASE>; timeout-ms = <TIMEOUT_COMBO_3>; key-positions = <KEY_A KEY_T KEY_S>; bindings = <&kp Q>; };
		combo_x            { layers = <LAYER_ID_BASE>; timeout-ms = <TIMEOUT_COMBO_3>; key-positions = <KEY_R KEY_T KEY_S>; bindings = <&kp X>; };
		combo_l            { layers = <LAYER_ID_BASE>; timeout-ms = <TIMEOUT_COMBO_3>; key-positions = <KEY_E KEY_Y KEY_I>; bindings = <&kp L>; };
		combo_single_quote { layers = <LAYER_ID_BASE>; timeout-ms = <TIMEOUT_COMBO_3>; key-positions = <KEY_A KEY_Y KEY_I>; bindings = <&kp SQT>; };

		/*****************************************
		 * 4 key combos
		 *****************************************/
		combo_tab             { timeout-ms = <TIMEOUT_COMBO_4>; key-positions = <KEY_A KEY_R KEY_T KEY_O>; bindings = <&kp TAB>; };
		combo_space           { timeout-ms = <TIMEOUT_COMBO_4>; key-positions = <KEY_E KEY_Y KEY_I KEY_O>; bindings = <&kp SPACE>; };
		combo_shift           { timeout-ms = <TIMEOUT_COMBO_4>; key-positions = <KEY_E KEY_R KEY_T KEY_S>; bindings = <&sk LSHFT>; };
		combo_layer_bt_select { timeout-ms = <TIMEOUT_COMBO_4>; key-positions = <KEY_A KEY_E KEY_S KEY_O>; bindings = <&tog LAYER_ID_BT_SEL>; };
		combo_bt_clr          { timeout-ms = <TIMEOUT_COMBO_4>; key-positions = <KEY_R KEY_Y KEY_T KEY_I>; bindings = <&bt BT_CLR>; };

		combo_z         { layers = <LAYER_ID_BASE>; timeout-ms = <TIMEOUT_COMBO_4>; key-positions = <KEY_A KEY_R KEY_T KEY_S>; bindings = <&kp Z>; };
		combo_caps_lock { layers = <LAYER_ID_BASE>; timeout-ms = <TIMEOUT_COMBO_4>; key-positions = <KEY_O KEY_I KEY_Y KEY_A>; bindings = <&kp CAPS>; };
	};
};

/*****************************************
 * Standard ARTSEY layer activation definitions
 * These should NOT be changed and are global in scope
 *****************************************/
{
	behaviors {
		layer_base_kp: layer_base_kp {
			compatible = "zmk,behavior-hold-tap";
			label = "layer_base_kp";
			#binding-cells = <2>;
			tapping_term_ms = <TIMEOUT_LAYER_HOLD>;
			flavor = "tap-preferred";
			bindings = <&mo>, <&kp>;
		};
		layer_numbers_kp: layer_numbers_kp {
			compatible = "zmk,behavior-hold-tap";
			label = "layer_numbers_kp";
			#binding-cells = <2>;
			tapping_term_ms = <TIMEOUT_LAYER_HOLD>;
			flavor = "tap-preferred";
			bindings = <&mo>, <&kp>;
		};
		layer_symbols_kp: layer_symbols_kp {
			compatible = "zmk,behavior-hold-tap";
			label = "layer_symbols_kp";
			#binding-cells = <2>;
			tapping_term_ms = <TIMEOUT_LAYER_HOLD>;
			flavor = "tap-preferred";
			bindings = <&mo>, <&kp>;
		};
		layer_parentheticals_kp: layer_parentheticals_kp {
			compatible = "zmk,behavior-hold-tap";
			label = "layer_parentheticals_kp";
			#binding-cells = <2>;
			tapping_term_ms = <TIMEOUT_LAYER_HOLD>;
			flavor = "tap-preferred";
			bindings = <&mo>, <&kp>;
		};
		layer_custom_kp: layer_custom_kp {
			compatible = "zmk,behavior-hold-tap";
			label = "layer_custom_kp";
			#binding-cells = <2>;
			tapping_term_ms = <TIMEOUT_LAYER_HOLD>;
			flavor = "tap-preferred";
			bindings = <&mo>, <&kp>;
		};
		ctrl_alt_kp: ctrl_alt_kp {
			compatible = "zmk,behavior-hold-tap";
			label = "ctrl_alt_kp";
			#binding-cells = <2>;
			tapping_term_ms = <TIMEOUT_LAYER_HOLD>;
			flavor = "tap-preferred";
			bindings = <&sk>, <&sk>;
		};
	};
};
