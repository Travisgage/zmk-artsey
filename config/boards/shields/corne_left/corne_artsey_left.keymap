/*
 * Copyright (c) 2021 Mike "KemoNine" Crosson
 *
 * SPDX-License-Identifier: MIT
 */

#include <behaviors.dtsi>
#include <dt-bindings/zmk/keys.h>
#include <dt-bindings/zmk/bt.h>

// Enable ARTSEY Left
#define ARTSEY_LEFT 1

// ARTS Row
#define KEY_A 4
#define KEY_R 3
#define KEY_T 2
#define KEY_S 1

// EYIO Row
#define KEY_E 10
#define KEY_Y 9
#define KEY_I 8
#define KEY_O 7

// Outer/unused keys become real keys now:

// K00
#define LEADING_NONES  &kp LC(C)

// K05, K10
#define MIDDLE_NONES   &kp LC(V) &kp LCTRL

// K15, K20-K25, T0-T2 (10 total)
// IMPORTANT: single-line macro (no "\" continuations)
// Swapped LSHFT and BACKSPACE on thumbs:
#define TRAILING_NONES &kp ENTER &kp TAB &kp LEFT &kp DOWN &kp UP &kp RIGHT &kp LG(H) &kp BACKSPACE &kp LSHFT &kp SPACE

// Include main artsey.io keymap
#include "../../../artsey.dtsi"
